## conf/layer.conf
```bitbake
# We have a conf and classes directory, add to BBPATH
BBPATH .= ":${LAYERDIR}"

# We have recipes-* directories, add to BBFILES
BBFILES += "${LAYERDIR}/recipes-*/*/*.bb \
            ${LAYERDIR}/recipes-*/*/*.bbappend"

BBFILE_COLLECTIONS += "meta-j0nix"
BBFILE_PATTERN_meta-j0nix = "^${LAYERDIR}/"
BBFILE_PRIORITY_meta-j0nix = "9"

LAYERDEPENDS_meta-j0nix = "core"
LAYERSERIES_COMPAT_meta-j0nix = "scarthgap"
```
